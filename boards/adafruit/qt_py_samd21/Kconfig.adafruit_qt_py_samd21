## boards/adafruit/qt_py_samd21/Kconfig.adafruit_qt_py_samd21
```kconfig
# Copyright (c) 2026 The Zephyr Project Contributors
# SPDX-License-Identifier: Apache-2.0

config BOARD_ADAFRUIT_QT_PY_SAMD21
	select SOC_SAMD21E18A
```

## boards/adafruit/qt_py_samd21/board.yml
```yaml
board:
  name: adafruit_qt_py_samd21
  full_name: QT Py SAMD21
  vendor: adafruit
  socs:
  - name: samd21e18a
```
